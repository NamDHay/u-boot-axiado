## arch/arm/mach-axiado/Kconfig
```kconfig
if ARCH_AXIADO

config SYS_ARCH
	default "arm"

config SYS_SOC
	default "axiado"

choice
	prompt "Axiado SoC select"
	depends on ARCH_AXIADO
	default AXIADO_AX3005

config AXIADO_AX3000
	bool "Support Axiado AX3000 SoC"
	select ARM64
	select ARMV8_SWITCH_TO_EL1
	select DM
	select DM_SERIAL
	select GICV3
	select ZYNQ_SERIAL
	help
	  The Axiado AX3000 SCM3000 is a ARM-based SoC with A53 CPU.
	  It is used as Board Management Controller on many server boards,
	  which is enabled by support of LPC and eSPI peripherals.

config AXIADO_AX3005
	bool "Support Axiado AX3005 SoC"
	select ARM64
	select ARMV8_SWITCH_TO_EL1
	select DM
	select DM_SERIAL
	select GICV3
	select ZYNQ_SERIAL
	help
	  The Axiado AX3005 SCM3005 is a ARM-based SoC with A53 CPU.
	  It is used as Board Management Controller on many server boards,
	  which is enabled by support of LPC and eSPI peripherals.

config AXIADO_MK
	bool "Support Axiado AX3000 running from A53 OCM (mk)"
	select ARM64
	select ARMV8_SWITCH_TO_EL1
	select DM
	select DM_SERIAL
	select GICV3
	select ZYNQ_SERIAL
	help
	  AX3000 (quad-core Cortex-A53) SCM3000 clone whose U-Boot runs
	  entirely from the 1 MiB A53 on-chip SRAM at 0x80200000, without
	  relocation, so it does not need DDR. Diagnostics use the AX3000
	  (A0) register map.

endchoice

source "arch/arm/mach-axiado/scm3000/Kconfig"
source "arch/arm/mach-axiado/scm3005/Kconfig"
source "arch/arm/mach-axiado/mk/Kconfig"

endif
```

## arch/arm/mach-axiado/mk/Kconfig
```kconfig
if AXIADO_MK

config TARGET_MK
	bool "Support Axiado AX3000 SCM3000 from A53 OCM (mk)"
	help
	  SCM3000 board support with U-Boot linked and running in the
	  1 MiB A53 OCM (0x80200000) instead of DDR.

source "board/axiado/mk/Kconfig"

endif
```

## arch/arm/mach-axiado/scm3000/Kconfig
```kconfig
if AXIADO_AX3000

config TARGET_SCM3000
	bool "Support Axiado AX3000 SCM3000"
	help
	  Support for the Axiado AX3000 SCM3000 board.
	  Based on the Axiado AX3000 quad-core ARMv8 Cortex-A53 SoC.

source "board/axiado/scm3000/Kconfig"

endif
```

## board/axiado/mk/Kconfig
```kconfig
if TARGET_MK

config SYS_BOARD
	string
	default "mk"

config SYS_VENDOR
	string
	default "axiado"

config SYS_CONFIG_NAME
	string
	default "mk"

endif
```

## board/axiado/scm3000/Kconfig
```kconfig
if TARGET_SCM3000

config SYS_BOARD
	string
	default "scm3000"

config SYS_VENDOR
	string
	default "axiado"

config SYS_CONFIG_NAME
	string
	default "ax3000-scm3000"

endif
```

## cmd/diag/Kconfig
```kconfig
config CMD_AX_ADC
	bool "ax_adc - Axiado ADC diagnostics"
	depends on ARCH_AXIADO
	depends on CMD_AX_DIAG
	help
	  This command provides access to ADC board diagnostic tests.

config INNO_ADC
	bool "Innosilicon SARADC support"
	help
	  This config support for Innosilicon SARADC.

config CMD_AX_EMMC
	bool "ax_emmc - Axiado eMMC diagnostics"
	depends on ARCH_AXIADO
	depends on CMD_AX_DIAG
	help
	  This command provides access to eMMC board diagnostic tests.

config ARASAN_SDHCI
	bool "Arasan SDHCI support"
	help
	  This config support for Arasan SDHCI.

config CMD_AX_ETH
	bool "ax_eth - Axiado Ethernet diagnostics"
	depends on ARCH_AXIADO
	depends on CMD_AX_DIAG
	help
	  This command provides access to Ethernet (SGMII/RMII) diagnostic tests.

config AXIADO_HCP_ETH
	bool "Axiado HCP Ethernet support"
	help
	  This config support for the Axiado HCP Ethernet MAC/MDIO (diag HAL).

config CMD_AX_GPIO
	bool "ax_gpio - Axiado GPIO diagnostics"
	depends on ARCH_AXIADO
	depends on CMD_AX_DIAG
	help
	  This command provides access to GPIO board diagnostic tests.

config CDNS_GPIO
	bool "Cadence GPIO support"
	help
	  This config support for Cadence GPIO.

config CMD_AX_HDMI
	bool "ax_hdmi - Axiado HDMI diagnostics"
	depends on ARCH_AXIADO
	depends on CMD_AX_DIAG
	help
	  This command provides access to HDMI board diagnostic tests.

config INNO_HDMI
	bool "Innosilicon HDMI support"
	help
	  This config support for Innosilicon HDMI.

config CMD_AX_I2C
	bool "ax_i2c - Axiado I2C diagnostics"
	depends on ARCH_AXIADO
	depends on CMD_AX_DIAG
	depends on AXIADO_AX3005
	help
	  This command provides access to I2C board diagnostic tests.

config CDNS_I2C
	bool "Cadence I2C support"
	depends on AXIADO_AX3005
	help
	  This config support for Cadence I2C.

config CMD_AX_I3C
	bool "ax_i3c - Axiado I3C diagnostics"
	depends on ARCH_AXIADO
	depends on CMD_AX_DIAG
	help
	  This command provides access to I3C board diagnostic tests.

config CDNS_I3C
	bool "Cadence I3C support"
	help
	  This config support for Cadence I3C.

config CMD_AX_JTAG
	bool "ax_jtag - Axiado Host JTAG diagnostics"
	depends on ARCH_AXIADO
	depends on CMD_AX_DIAG
	help
	  This command provides access to Host JTAG board diagnostic tests.

config AXIADO_JTAG
	bool "Axiado JTAG support"
	help
	  This config support for Axiado Host JTAG.

config CMD_AX_LTPI
	bool "ax_jtag - Axiado LTPI diagnostics"
	depends on ARCH_AXIADO
	depends on CMD_AX_DIAG
	help
	  This command provides access to LTPI board diagnostic tests.

config AXIADO_LTPI
	bool "Axiado LTPI support"
	help
	  This config support for Axiado LTPI.

config CMD_AX_MBX
	bool "ax_mbx - Axiado Hardware Mailbox diagnostics"
	depends on ARCH_AXIADO
	depends on CMD_AX_DIAG
	depends on AXIADO_AX3005
	help
	  This command provides access to Hardware Mailbox board diagnostic tests.

config AXIADO_MBOX
	bool "Axiado SoCs Mailbox support"
	depends on ARCH_AXIADO
	depends on CMD_AX_DIAG
	depends on AXIADO_AX3005
	help
	  This config support for Axiado SoCs Mailbox.

config CMD_AX_MEM
	bool "ax_mem - Axiado MEM diagnostics"
	depends on ARCH_AXIADO
	depends on CMD_AX_DIAG
	help
	  This command provides access to MEM board diagnostic tests.

config CMD_AX_PCIE
	bool "ax_pcie - Axiado PCIE diagnostics"
	depends on ARCH_AXIADO
	depends on CMD_AX_DIAG
	help
	  This command provides access to PCIE board diagnostic tests.

config INNO_PCIE
	bool "Innosilicon PCIe support"
	depends on ARCH_AXIADO
	depends on CMD_AX_DIAG
	help
	  This config support for Innosilicon PCIe.

config CMD_AX_NVME
	bool "ax_nvme - Axiado NVME diagnostics"
	depends on ARCH_AXIADO
	depends on CMD_AX_DIAG
	help
	  This command provides access to NVME board diagnostic tests.

config CMD_AX_E1000
	bool "ax_nvme - Axiado E1000 diagnostics"
	depends on ARCH_AXIADO
	depends on CMD_AX_DIAG
	help
	  This command provides access to E1000 board diagnostic tests.

config AXIADO_PINMUX
	bool "Axiado pinmuxing support"
	help
	  This config support for Axiado pinmuxing.

config CMD_AX_PWM
	bool "ax_pwm - Axiado PWM diagnostics"
	depends on ARCH_AXIADO
	depends on CMD_AX_DIAG
	help
	  This command provides access to PWM board diagnostic tests.

config CDNS_PWM
	bool "Cadence PWM support"
	help
	  This config support for Cadence PWM.

config CMD_AX_RTC
	bool "ax_rtc - Axiado RTC diagnostics"
	depends on ARCH_AXIADO
	depends on CMD_AX_DIAG
	help
	  This command provides access to RTC board diagnostic tests.

config CDNS_RTC
	bool "Cadence RTC support"
	help
	  This config support for Cadence RTC.

config CMD_AX_SGPIO
	bool "ax_sgpio - Axiado SGPIO diagnostics"
	depends on ARCH_AXIADO
	depends on CMD_AX_DIAG
	help
	  This command provides access to SGPIO board diagnostic tests.

config AXIADO_SGPIO
	bool "Axiado SGPIO support"
	help
	  This config support for Axiado SGPIO.

config CMD_AX_SPI
	bool "ax_spi - Axiado SPI diagnostics"
	depends on ARCH_AXIADO
	depends on CMD_AX_DIAG
	help
	  This command provides access to SPI board diagnostic tests.

config DWC_SPI
	bool "Designware Master SPI support"
	depends on AXIADO_AX3005
	help
	  This config support for Designware Master SPI.

config CMD_AX_FLASH
	bool "ax_flash - Axiado SPI Nor Flash diagnostics"
	depends on ARCH_AXIADO
	depends on CMD_AX_DIAG
	help
	  This command provides access to SPI Nor Flash board diagnostic tests.

config CMD_AX_EEPROM
	bool "ax_eeprom - Axiado Eeprom diagnostics"
	depends on ARCH_AXIADO
	depends on CMD_AX_DIAG
	help
	  This command provides access to epprom board diagnostic tests.

config CMD_AX_TSENS
	bool "ax_tmp - Axiado TMP75 diagnostics"
	depends on ARCH_AXIADO
	depends on CMD_AX_DIAG
	help
	  This command provides access to TMP75 board diagnostic tests.

config CMD_AX_VSENS
	bool "ax_ina - Axiado INA232 diagnostics"
	depends on ARCH_AXIADO
	depends on CMD_AX_DIAG
	help
	  This command provides access to INA232 board diagnostic tests.

config CMD_AX_UART
	bool "ax_uart - Axiado UART diagnostics"
	depends on ARCH_AXIADO
	depends on CMD_AX_DIAG
	help
	  This command provides access to UART board diagnostic tests.

config CDNS_UART
	bool "Cadence UART support"
	help
	  This config support for Cadence UART.

config CMD_AX_WDT
	bool "ax_wdt - Axiado WatchDog diagnostics"
	depends on ARCH_AXIADO
	depends on CMD_AX_DIAG
	help
	  This command provides access to WDT board diagnostic tests.

config CDNS_WDT
	bool "Cadence WatchDog support"
	help
	  This config support for Cadence WDT.

config AXIADO_WDT
	bool "Axiado WatchDog support"
	help
	  This config support for Axiado WDT.

config CMD_AX_USB
	bool "ax_usb - Axiado USB diagnostics"
	depends on ARCH_AXIADO
	depends on CMD_AX_DIAG
	help
	  This command provides access to USB board diagnostic tests.

config AXIADO_USB
	bool "Axiado SoCs USB support"
	help
	  This config support for Axiado SoCs USB.

config CRG_XHCI
	bool "Corigine XHCI support"
	help
	  This config support for Corigine XHCI.
```

## configs/ax3005_scm3005_defconfig
```kconfig
CONFIG_ARM=y
CONFIG_ARM64=y
CONFIG_IRQ=y
CONFIG_GICV2=n
CONFIG_GICV3=y
CONFIG_GIC_V3_ITS=y
CONFIG_USE_SEPARATE_FAULT_HANDLERS=y
CONFIG_ARCH_AXIADO=y
CONFIG_POSITION_INDEPENDENT=y
CONFIG_TEXT_BASE=0x80000000
CONFIG_SYS_MONITOR_BASE=0x80000000
CONFIG_SYS_LOAD_ADDR=0x80100000
CONFIG_SYS_MALLOC_F_LEN=0x8000
CONFIG_SYS_MALLOC_LEN=0x20000
CONFIG_SYS_BOOTM_LEN=0x20000000
CONFIG_ENV_SIZE=0x20000
CONFIG_ENV_OFFSET=0x5000
CONFIG_NR_DRAM_BANKS=1
CONFIG_COUNTER_FREQUENCY=1000000000
CONFIG_SMP=y
CONFIG_NR_CPUS=4
CONFIG_ARMV8_MULTIENTRY=y
CONFIG_ARMV8_SET_SMPEN=y
CONFIG_ARMV8_SPIN_TABLE=y
CONFIG_SYS_CUSTOM_LDSCRIPT=y
CONFIG_SYS_LDSCRIPT="board/axiado/scm3005/u-boot.lds"
CONFIG_FIT=y
CONFIG_OF_BOARD_SETUP=y
CONFIG_USE_PREBOOT=y
CONFIG_DEFAULT_FDT_FILE="ax3005-scm3005.dtb"
# CONFIG_DISPLAY_CPUINFO is not set
CONFIG_HUSH_PARSER=y
CONFIG_SYS_PROMPT="Axiado> "
CONFIG_AUTOBOOT_KEYED=n
CONFIG_AUTOBOOT_PROMPT="Press \"<Esc><Esc>\" to stop autobooting in %d seconds\n"
CONFIG_AUTOBOOT_STOP_STR="\x1b\x1b"
CONFIG_USE_BOOTARGS=n
CONFIG_USE_BOOTCOMMAND=n
CONFIG_BOOTCOMMAND="setenv ipaddr 10.7.10.14; setenv gatewayip 10.7.10.1; setenv netmask 255.255.255.0; dcache off"
CONFIG_SYS_VENDOR="axiado"
CONFIG_SYS_BOARD="scm3005"
CONFIG_SYS_CONFIG_NAME="ax3005-scm3005"
CONFIG_MISC_INIT_R=y
CONFIG_CMD_NVEDIT_EFI=y
CONFIG_CMD_MEMTEST=y
CONFIG_SYS_ALT_MEMTEST=y
CONFIG_CMD_CLK=y
CONFIG_CMD_DFU=y
CONFIG_CMD_TFTPPUT=y
CONFIG_CMD_CACHE=y
CONFIG_CMD_EXT2=y
CONFIG_CMD_EXT4=y
CONFIG_CMD_EXT4_WRITE=y
CONFIG_CMD_FAT=y
CONFIG_CMD_FS_GENERIC=y
CONFIG_OF_CONTROL=y
CONFIG_OF_SEPARATE=y
CONFIG_DEFAULT_DEVICE_TREE="ax3005-scm3005"
CONFIG_MULTI_DTB_FIT=y
CONFIG_TARGET_SCM3005=y
CONFIG_CLK=y
CONFIG_LZMA=y
CONFIG_XZ=y
CONFIG_ZYNQ_SERIAL=y

# CONFIG_AUTO_COMPLETE is not set
# CONFIG_SYS_LONGHELP is not set
# CONFIG_TOOLS_MKEFICAPSULE is not set

CONFIG_CMD_GO=y

CONFIG_LOG=y
CONFIG_LOGLEVEL=3
CONFIG_LOG_MAX_LEVEL=3
CONFIG_DM_DEBUG=y
CONFIG_CMDLINE=y
CONFIG_AUTO_COMPLETE=y
CONFIG_SYS_LONGHELP=y

CONFIG_CMD_AX_DIAG=y
CONFIG_CMD_AX_ADC=y 	
CONFIG_CMD_AX_GPIO=y 	
CONFIG_CMD_AX_HDMI=y 	
CONFIG_CMD_AX_I2C=y 	
CONFIG_CMD_AX_I3C=y 	
CONFIG_CMD_AX_MEM=y 	
CONFIG_CMD_AX_PCIE=y 	
CONFIG_CMD_AX_NVME=y 	
CONFIG_CMD_AX_PWM=y 	
CONFIG_CMD_AX_RTC=y 	
CONFIG_CMD_AX_SGPIO=y 	
CONFIG_CMD_AX_SPI=y 	
CONFIG_CMD_AX_FLASH=y 	
CONFIG_CMD_AX_EEPROM=y 	
CONFIG_CMD_AX_TSENS=y 	
CONFIG_CMD_AX_VSENS=y 	
CONFIG_CMD_AX_UART=y 	

CONFIG_INNO_ADC=y
CONFIG_ARASAN_SDHCI=y
CONFIG_CDNS_GPIO=y
CONFIG_INNO_HDMI=y
CONFIG_CDNS_I2C=y
CONFIG_CDNS_I3C=y
CONFIG_CDNS_PWM=y
CONFIG_CDNS_RTC=y
CONFIG_AXIADO_SGPIO=y
CONFIG_DWC_SPI=y
CONFIG_CDNS_UART=y
CONFIG_AXIADO_PINMUX=y
CONFIG_INNO_PCIE=y
```

## configs/mk_defconfig
```kconfig
# SPDX-License-Identifier: GPL-2.0+
#
# Copyright (c) 2021-25 Axiado Corporation (or its affiliates).

CONFIG_ARM=y
CONFIG_ARM64=n
CONFIG_IRQ=y
CONFIG_GICV3=y
CONFIG_GIC_V3_ITS=y
CONFIG_USE_SEPARATE_FAULT_HANDLERS=y
CONFIG_ARCH_AXIADO=y
CONFIG_AXIADO_MK=y
CONFIG_TARGET_MK=y
CONFIG_POSITION_INDEPENDENT=y
# Runs in place from the 1 MiB A53 OCM (0x80200000), no relocation.
CONFIG_TEXT_BASE=0x80200000
CONFIG_SYS_MONITOR_BASE=0x80200000
CONFIG_EXPERT=y
CONFIG_SKIP_RELOCATE=y
# Early stack/gd/malloc_f at a fixed OCM address (CFG_SYS_INIT_RAM_ADDR in mk.h)
# CONFIG_INIT_SP_RELATIVE is not set
# Default load address is in DDR (only usable once DDR is initialised)
CONFIG_SYS_LOAD_ADDR=0x3C100000
CONFIG_SYS_MALLOC_F_LEN=0x8000
CONFIG_SYS_MALLOC_LEN=0x30000
CONFIG_SYS_BOOTM_LEN=0x20000000
CONFIG_ENV_SIZE=0x2000
CONFIG_ENV_OFFSET=0x5000
CONFIG_NR_DRAM_BANKS=2
CONFIG_COUNTER_FREQUENCY=800000000
CONFIG_ARMV8_MULTIENTRY=y
CONFIG_ARMV8_SET_SMPEN=y
CONFIG_ARMV8_SPIN_TABLE=y
CONFIG_SYS_CUSTOM_LDSCRIPT=y
CONFIG_SYS_LDSCRIPT="board/axiado/mk/u-boot.lds"
CONFIG_FIT=y
CONFIG_OF_BOARD_SETUP=y
CONFIG_USE_PREBOOT=y
CONFIG_DEFAULT_FDT_FILE="mk.dtb"
# CONFIG_DISPLAY_CPUINFO is not set
CONFIG_HUSH_PARSER=y
CONFIG_SYS_PROMPT="Axiado> "
CONFIG_AUTOBOOT_KEYED=n
CONFIG_AUTOBOOT_PROMPT="Press \"<Esc><Esc>\" to stop autobooting in %d seconds\n"
CONFIG_AUTOBOOT_STOP_STR="\x1b\x1b"
CONFIG_USE_BOOTARGS=n
CONFIG_USE_BOOTCOMMAND=n
CONFIG_SYS_VENDOR="axiado"
CONFIG_SYS_BOARD="mk"
CONFIG_SYS_CONFIG_NAME="mk"
CONFIG_MISC_INIT_R=y
CONFIG_SYS_ALT_MEMTEST=y
CONFIG_OF_CONTROL=y
CONFIG_OF_SEPARATE=y
CONFIG_DEFAULT_DEVICE_TREE="mk"
CONFIG_MULTI_DTB_FIT=y
CONFIG_CLK=y
CONFIG_LZMA=y
CONFIG_XZ=y
CONFIG_ZYNQ_SERIAL=y

# CONFIG_AUTO_COMPLETE is not set
# CONFIG_SYS_LONGHELP is not set
# CONFIG_TOOLS_MKEFICAPSULE is not set

CONFIG_CMD_GO=y

CONFIG_LOG=y
CONFIG_LOGLEVEL=3
CONFIG_LOG_MAX_LEVEL=3
CONFIG_DM_DEBUG=y
CONFIG_CMDLINE=y
CONFIG_AUTO_COMPLETE=y
CONFIG_SYS_LONGHELP=y

CONFIG_CMD_AX_DIAG=y
# ax_diag record in the reserved top 16 KiB of OCM (MK_OCM_RSVD_SIZE)
CONFIG_CMD_AX_DIAG_RECORD_ADDR=0x802FC000
CONFIG_CMD_AX_ADC=y 	
CONFIG_CMD_AX_EMMC=y 	
CONFIG_CMD_AX_GPIO=y 	
CONFIG_CMD_AX_HDMI=y 	
CONFIG_CMD_AX_I2C=n
CONFIG_CMD_AX_I3C=y 	
CONFIG_CMD_AX_LTPI=y
CONFIG_CMD_AX_MBX=y 	
CONFIG_CMD_AX_MEM=y 	
CONFIG_CMD_AX_PCIE=y 	
CONFIG_CMD_AX_NVME=y 	
CONFIG_CMD_AX_E1000=y
CONFIG_CMD_AX_PWM=y 	
CONFIG_CMD_AX_RTC=y 	
CONFIG_CMD_AX_SGPIO=n
CONFIG_CMD_AX_SPI=y 	
CONFIG_CMD_AX_FLASH=y 	
CONFIG_CMD_AX_EEPROM=y 	
CONFIG_CMD_AX_TSENS=y 	
CONFIG_CMD_AX_VSENS=y 	
CONFIG_CMD_AX_UART=y 	
CONFIG_CMD_AX_WDT=y 	
CONFIG_CMD_AX_USB=y 	

CONFIG_INNO_ADC=y
CONFIG_ARASAN_SDHCI=y
CONFIG_CDNS_GPIO=y
CONFIG_INNO_HDMI=y
CONFIG_CDNS_I2C=n
CONFIG_CDNS_I3C=y
CONFIG_AXIADO_LTPI=y
CONFIG_AXIADO_MBOX=y
CONFIG_INNO_PCIE=y
CONFIG_AXIADO_PINMUX=y
CONFIG_CDNS_PWM=y
CONFIG_CDNS_RTC=y
CONFIG_AXIADO_SGPIO=n
CONFIG_DWC_SPI=n
CONFIG_CDNS_UART=y
CONFIG_CNDS_WDT=y
CONFIG_AXIADO_XHCI=y
CONFIG_CRG_XHCI=y

CONFIG_KALLSYMS=y
```

## drivers/video/axiado/Kconfig
```kconfig
# SPDX-License-Identifier: GPL-2.0-only
config VIDEO_AXIADO
	bool "Axiado video driver"
	depends on VIDEO
	help
		Video driver for the Axiado KVM requirement.

config AXIADO_HDMI
	bool "Axiado specific extensions HDMI"
	depends on VIDEO
	depends on VIDEO_AXIADO
	help
	  Choose this option to enable support for the Axiado AX3000
	  HDMI driver. If you want to use the AX3000 SoC integrated HDMI or related
	  display controllers under the Direct Rendering Manager (DRM)
	  framework, say Y or M here.

	  If unsure, say N.
```
